## components/can_driver/Kconfig
```kconfig
menu "CalSol CAN driver"
config CAN_SELF_TEST
    bool "Allow transmission without peer ACK (bench self-test only)"
    default n
    help
        Successful transmission in this mode is not evidence of peer reception.
        Physical verification must independently assert RX captures.
endmenu
```

## debugger_fw/sdkconfig.defaults
```kconfig
CONFIG_IDF_TARGET="esp32s3"
CONFIG_ESP_CONSOLE_NONE=y
CONFIG_ESP_CONSOLE_SECONDARY_NONE=y
CONFIG_CAN_SELF_TEST=n
```

## templates/can-unit-test/test/main/Kconfig.projbuild
```kconfig
menu "CAN message test options"
config CAN_TEST_PHYSICAL_RX
    bool "Run physical CAN request/reply test (requires host responder)"
    default n
endmenu
```
